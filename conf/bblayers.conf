## conf/bblayers.conf
```bitbake
BBPATH = "${TOPDIR}"
BBFILES ?= ""

BBLAYERS ?= " \
  ${ROOT}/layers/meta \
  ${ROOT}/layers/meta-poky \
  ${ROOT}/layers/meta-microblaze \
  ${ROOT}/layers/meta-xilinx-core \
  ${ROOT}/layers/meta-xilinx-standalone \
  ${ROOT}/layers/meta-xilinx-bsp \
  ${ROOT}/layers/meta-xilinx-vendor \
  ${ROOT}/layers/meta-xilinx-tools \
  ${ROOT}/layers/meta-perl \
  ${ROOT}/layers/meta-python \
  ${ROOT}/layers/meta-filesystems \
  ${ROOT}/layers/meta-gnome \
  ${ROOT}/layers/meta-multimedia \
  ${ROOT}/layers/meta-networking \
  ${ROOT}/layers/meta-webserver \
  ${ROOT}/layers/meta-xfce \
  ${ROOT}/layers/meta-initramfs \
  ${ROOT}/layers/meta-oe \
  ${ROOT}/repos/meta-xilinx/meta-xilinx-contrib \
  ${ROOT}/layers/meta-virtualization \
  ${ROOT}/layers/meta-openamp \
  ${ROOT}/layers/meta-kria \
  ${ROOT}/repos/meta-security \
  ${ROOT}/layers/meta-tpm \
  ${ROOT}/layers/meta-xilinx-tsn \
  ${ROOT}/layers/meta-petalinux \
  ${ROOT}/layers/meta-qt5 \
  ${ROOT}/layers/meta-aws \
  ${ROOT}/layers/meta-jupyter \
  ${ROOT}/layers/meta-system-controller \
  ${ROOT}/layers/meta-mmr-custom \
  ${ROOT}/layers/meta-ros2 \
  ${ROOT}/layers/meta-ros2-foxy \
  ${ROOT}/layers/meta-ros-common \
  ${ROOT}/layers/meta-fixes \
  "
```

## layers/meta-fixes/conf/layer.conf
```bitbake
# We have a conf and classes directory, add to BBPATH
BBPATH .= ":${LAYERDIR}"

# We have recipes-* directories, add to BBFILES
BBFILES += "${LAYERDIR}/recipes-*/*/*.bb \
            ${LAYERDIR}/recipes-*/*/*.bbappend"

BBFILE_COLLECTIONS += "meta-fixes"
BBFILE_PATTERN_meta-fixes = "^${LAYERDIR}/"
BBFILE_PRIORITY_meta-fixes = "6"

LAYERDEPENDS_meta-fixes = "core"
LAYERSERIES_COMPAT_meta-fixes = "nanbield"
```

## layers/meta-mmr-custom/conf/layer.conf
```bitbake
# We have a conf and classes directory, add to BBPATH
BBPATH .= ":${LAYERDIR}"

# We have recipes-* directories, add to BBFILES
BBFILES += "${LAYERDIR}/recipes-*/*/*.bb \
            ${LAYERDIR}/recipes-*/*/*.bbappend"

BBFILE_COLLECTIONS += "meta-mmr-custom"
BBFILE_PATTERN_meta-mmr-custom = "^${LAYERDIR}/"
BBFILE_PRIORITY_meta-mmr-custom = "6"

LAYERDEPENDS_meta-mmr-custom = "core"
LAYERSERIES_COMPAT_meta-mmr-custom = "nanbield"
```
